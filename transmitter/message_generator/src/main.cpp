#include <Arduino.h>
#include <SPI.h>
#include <mcp2515.h>

MCP2515 mcp2515(10); // CS on D10

struct CANMessage {
  uint32_t id;
  uint8_t  data[8];
};

// ── Cycle 1: BMS Status ───────────────────────────────────────────────────────
const CANMessage bms_cycle1[] = {
  {0x6B0, {0xD8, 0x03, 0xB6, 0x4E, 0x4B, 0x00, 0x03, 0xA1}},
  {0x6B1, {0x00, 0xFA, 0x00, 0x3C, 0x2A, 0x1E, 0x00, 0xB2}},
  {0x6B2, {0x0F, 0xD2, 0x07, 0x0F, 0x8C, 0x12, 0x00, 0xC3}},
  {0x6B3, {0x2A, 0x07, 0x1E, 0x12, 0x24, 0x28, 0xD4, 0x00}},
  {0x6B4, {0x01, 0xEA, 0x60, 0x2E, 0xE0, 0x00, 0x00, 0xE5}},
};

// ── Cycle 1: Cell Voltages ────────────────────────────────────────────────────
const CANMessage cells_cycle1[] = {
  {0x36, {0x01, 0x0F, 0xBE, 0x00, 0x28, 0x0F, 0xB4, 0xF1}},
  {0x36, {0x02, 0x0F, 0xC0, 0x00, 0x27, 0x0F, 0xB6, 0xF2}},
  {0x36, {0x03, 0x0F, 0xBC, 0x00, 0x29, 0x0F, 0xB2, 0xF3}},
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  {0x36, {0x18, 0x0F, 0x8C, 0x00, 0x2A, 0x0F, 0x82, 0xF3}},
};

// ── Cycle 2: BMS Updates (dynamic conditions) ─────────────────────────────────
const CANMessage bms_cycle2[] = {
  {0x6B0, {0xE0, 0x03, 0xB6, 0x4C, 0x4B, 0x00, 0x03, 0xA9}},
  {0x6B1, {0x00, 0xFA, 0x00, 0x3C, 0x2B, 0x1E, 0x00, 0xB3}},
  {0x6B2, {0x0F, 0xD0, 0x07, 0x0F, 0x8E, 0x12, 0x00, 0xC5}},
  {0x6B3, {0x2B, 0x07, 0x1E, 0x12, 0x25, 0x29, 0xD5, 0x00}},
  {0x6B4, {0x01, 0xEA, 0x5F, 0x2E, 0xDF, 0x00, 0x00, 0xE4}},
};

// ── Cycle 3: BMS Updates (accelerating, SOC dropping) ─────────────────────────
const CANMessage bms_cycle3[] = {
  {0x6B0, {0xF0, 0x03, 0xB6, 0x48, 0x4A, 0x00, 0x03, 0xB1}},
  {0x6B1, {0x00, 0xFA, 0x00, 0x3C, 0x2C, 0x1F, 0x00, 0xB4}},
  {0x6B2, {0x0F, 0xCE, 0x07, 0x0F, 0x90, 0x12, 0x00, 0xC7}},
  {0x6B3, {0x2C, 0x07, 0x1F, 0x12, 0x26, 0x2A, 0xD6, 0x00}},
  {0x6B4, {0x01, 0xEA, 0x5E, 0x2E, 0xDE, 0x00, 0x00, 0xE3}},
};

// ── Cycle 3: Cell Voltage Updates (cells heating up) ──────────────────────────
const CANMessage cells_cycle3[] = {
  {0x36, {0x01, 0x0F, 0xBC, 0x00, 0x29, 0x0F, 0xB2, 0xF1}},
  {0x36, {0x07, 0x0F, 0xD0, 0x00, 0x27, 0x0F, 0xC6, 0xF7}},
  {0x36, {0x0C, 0x0F, 0xC2, 0x00, 0x2A, 0x0F, 0xB8, 0xF2}},
  {0x36, {0x18, 0x0F, 0x8A, 0x00, 0x2B, 0x0F, 0x80, 0xF3}},
  {0x36, {0x13, 0x0F, 0x8E, 0x00, 0x2C, 0x0F, 0x84, 0xF2}},
};

// ── Final BMS Update ──────────────────────────────────────────────────────────
const CANMessage bms_final[] = {
  {0x6B0, {0x00, 0x04, 0xB6, 0x44, 0x49, 0x00, 0x03, 0xB9}},
  {0x6B1, {0x00, 0xFA, 0x00, 0x3C, 0x2D, 0x20, 0x00, 0xB5}},
  {0x6B2, {0x0F, 0xCC, 0x07, 0x0F, 0x92, 0x12, 0x00, 0xC9}},
  {0x6B3, {0x2D, 0x07, 0x20, 0x12, 0x27, 0x2B, 0xD7, 0x00}},
  {0x6B4, {0x01, 0xEA, 0x5D, 0x2E, 0xDD, 0x00, 0x00, 0xE2}},
};

// ── Helper: send an array of CANMessages ──────────────────────────────────────
void sendMessages(const CANMessage* msgs, size_t count, uint16_t intervalMs = 10) {
  can_frame frame;
  frame.can_dlc = 8;

  for (size_t i = 0; i < count; i++) {
    frame.can_id = msgs[i].id;
    memcpy(frame.data, msgs[i].data, 8);

    MCP2515::ERROR err = mcp2515.sendMessage(&frame);

    Serial.print(err == MCP2515::ERROR_OK ? "[OK]  " : "[ERR] ");
    Serial.print("ID: 0x");
    Serial.print(msgs[i].id, HEX);
    Serial.print("  Data:");
    for (int b = 0; b < 8; b++) {
      Serial.print(" ");
      if (msgs[i].data[b] < 0x10) Serial.print("0");
      Serial.print(msgs[i].data[b], HEX);
    }
    Serial.println();

    delay(intervalMs);
  }
}

// ── Setup ─────────────────────────────────────────────────────────────────────
void setup() {
  Serial.begin(115200);
  while (!Serial);
  Serial.println("Booting...");

  SPI.begin();
  mcp2515.reset();
  mcp2515.setBitrate(CAN_500KBPS, MCP_8MHZ); // Change to MCP_16MHZ if needed
  mcp2515.setNormalMode();

  Serial.println("MCP2515 ready.\n");
}

// ── Loop ──────────────────────────────────────────────────────────────────────
void loop() {
  Serial.println("=== Cycle 1: BMS Status ===");
  sendMessages(bms_cycle1, sizeof(bms_cycle1) / sizeof(bms_cycle1[0]));

  Serial.println("=== Cycle 1: Cell Voltages ===");
  sendMessages(cells_cycle1, sizeof(cells_cycle1) / sizeof(cells_cycle1[0]));

  //delay(100);

  Serial.println("=== Cycle 2: BMS Updates ===");
  sendMessages(bms_cycle2, sizeof(bms_cycle2) / sizeof(bms_cycle2[0]));

  //delay(100);

  Serial.println("=== Cycle 3: BMS Updates ===");
  sendMessages(bms_cycle3, sizeof(bms_cycle3) / sizeof(bms_cycle3[0]));

  Serial.println("=== Cycle 3: Cell Voltage Updates ===");
  sendMessages(cells_cycle3, sizeof(cells_cycle3) / sizeof(cells_cycle3[0]));

  //delay(100);

  Serial.println("=== Final BMS Update ===");
  sendMessages(bms_final, sizeof(bms_final) / sizeof(bms_final[0]));

  Serial.println("\n--- Sequence complete, repeating in 1s ---\n");
  //delay(50);
}